#include "oled.h"
#include <stdio.h>
#include <string.h>

/* 运行时用（支持 0x3C/0x3D 两种模块） */
static uint16_t s_oled_addr = OLED_ADDRESS;

static HAL_StatusTypeDef OLED_I2C_Send(const uint8_t *buf, uint16_t len)
{
    return HAL_I2C_Master_Transmit(&OLED_I2C_HANDLE, (uint16_t)s_oled_addr, (uint8_t *)buf, len, 1000U);
}

static void OLED_DetectAddress(void)
{
    if (HAL_I2C_IsDeviceReady(&OLED_I2C_HANDLE, OLED_ADDRESS, 3U, 100U) == HAL_OK) {
        s_oled_addr = OLED_ADDRESS;
        return;
    }
    if (HAL_I2C_IsDeviceReady(&OLED_I2C_HANDLE, 0x7AU, 3U, 100U) == HAL_OK) {
        s_oled_addr = 0x7AU;
        return;
    }
    s_oled_addr = OLED_ADDRESS;
}

static void OLED_WriteData(uint8_t data)
{
    uint8_t buf[2] = {OLED_DATA, data};
    (void)OLED_I2C_Send(buf, 2U);
}

/* 页地址模式下列会自动 +1，可一次发送多列数据（减轻 I2C 负载） */
static void OLED_WriteDataBurst(const uint8_t *data, uint16_t len)
{
    uint8_t tmp[129];
    uint16_t chunk;
    uint16_t pos = 0U;
    while (pos < len) {
        chunk = len - pos;
        if (chunk > 128U) {
            chunk = 128U;
        }
        tmp[0] = OLED_DATA;
        memcpy(tmp + 1U, data + pos, chunk);
        (void)OLED_I2C_Send(tmp, (uint16_t)(chunk + 1U));
        pos += chunk;
    }
}

void OLED_WR_Byte(uint8_t dat, uint8_t cmd)
{
    uint8_t buf[2] = {cmd, dat};
    (void)OLED_I2C_Send(buf, 2U);
}

void OLED_Set_Pos(uint8_t x, uint8_t y)
{
    uint16_t px = (uint16_t)x + (uint16_t)OLED_COLUMN_OFFSET;
    if (px > 127U) {
        px = 127U;
    }
    OLED_WR_Byte((uint8_t)(0xB0U + y), OLED_CMD);
    OLED_WR_Byte((uint8_t)(((px & 0xF0U) >> 4) | 0x10U), OLED_CMD);
    OLED_WR_Byte((uint8_t)(px & 0x0FU), OLED_CMD);
}

const uint8_t F6x8[][6] = {
    {0x00,0x00,0x00,0x00,0x00,0x00},
    {0x00,0x00,0x5F,0x00,0x00,0x00},
    {0x00,0x07,0x00,0x07,0x00,0x00},
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    {0x08,0x1C,0x2A,0x08,0x08,0x00},
};

const uint8_t F8X16[96][16] = {{0}};

void OLED_Clear(void)
{
    static const uint8_t z128[128];
    static const uint8_t z2[2];
    uint8_t i;
    for (i = 0; i < OLED_PAGE_NUM; i++) {
        /* Start from physical column 0 to clear the offset columns too */
        OLED_WR_Byte((uint8_t)(0xB0U + i), OLED_CMD);
        OLED_WR_Byte(0x00, OLED_CMD);
        OLED_WR_Byte(0x10, OLED_CMD);
        OLED_WriteDataBurst(z2, (uint16_t)OLED_COLUMN_OFFSET);
        OLED_WriteDataBurst(z128, OLED_WIDTH);
    }
}

void OLED_Init(void)
{
    OLED_DetectAddress();

    HAL_Delay(120);
    OLED_WR_Byte(0xAE, OLED_CMD);
    OLED_WR_Byte(0xD5, OLED_CMD);
    OLED_WR_Byte(0x80, OLED_CMD);
    OLED_WR_Byte(0xA8, OLED_CMD);
    OLED_WR_Byte(0x3F, OLED_CMD);
    OLED_WR_Byte(0xD3, OLED_CMD);
    OLED_WR_Byte(0x00, OLED_CMD);
    OLED_WR_Byte(0x40, OLED_CMD);
    OLED_WR_Byte(0x8D, OLED_CMD);
    OLED_WR_Byte(0x14, OLED_CMD);
    OLED_WR_Byte(0x20, OLED_CMD);
    OLED_WR_Byte(0x02, OLED_CMD);
    OLED_WR_Byte(0xA1, OLED_CMD);
    OLED_WR_Byte(0xC8, OLED_CMD);
    OLED_WR_Byte(0xDA, OLED_CMD);
    OLED_WR_Byte(0x12, OLED_CMD);
    OLED_WR_Byte(0x81, OLED_CMD);
    OLED_WR_Byte(0xFF, OLED_CMD);
    OLED_WR_Byte(0xD9, OLED_CMD);
    OLED_WR_Byte(0xF1, OLED_CMD);
    OLED_WR_Byte(0xDB, OLED_CMD);
    OLED_WR_Byte(0x40, OLED_CMD);
    OLED_WR_Byte(0xA4, OLED_CMD);
    OLED_WR_Byte(0xA6, OLED_CMD);
    OLED_WR_Byte(0xAF, OLED_CMD);
    OLED_Clear();

#if OLED_PANEL_SELFTEST
    /* 整屏点亮（与 GRAM 无关）：不闪则 I2C/供电/器件未工作 */
    OLED_WR_Byte(0xA5, OLED_CMD);
    HAL_Delay(250);
    OLED_WR_Byte(0xA4, OLED_CMD);
    OLED_Clear();
#endif
}

void OLED_Display_On(void)
{
    OLED_WR_Byte(0x8D, OLED_CMD);
    OLED_WR_Byte(0x14, OLED_CMD);
    OLED_WR_Byte(0xAF, OLED_CMD);
}

void OLED_Display_Off(void)
{
    OLED_WR_Byte(0xAE, OLED_CMD);
}

void OLED_ShowChar(uint8_t x, uint8_t y, char chr)
{
    char buf[2] = {chr, '\0'};
    OLED_ShowString(x, y, buf);
}

void OLED_ShowString(uint8_t x, uint8_t y, const char *str)
{
    OLED_Set_Pos(x, y);
    while (*str != '\0') {
        uint8_t c = (uint8_t)*str;
        if (c < 32U || c > 126U) {
            str++;
            continue;
        }
        for (uint8_t i = 0; i < 6U; i++) {
            OLED_WriteData(F6x8[c - 32U][i]);
        }
        str++;
        x += 6U;
        OLED_Set_Pos(x, y);
    }
}

void OLED_ShowNumber(uint8_t x, uint8_t y, int num, uint8_t len)
{
    char buf[18];
    int w = (int)len;
    if (w > 17) {
        w = 17;
    }
    if (w < 1) {
        w = 1;
    }
    snprintf(buf, sizeof(buf), "%0*d", w, num);
    OLED_ShowString(x, y, buf);
}

void OLED_ShowFloat(uint8_t x, uint8_t y, float num, uint8_t int_len, uint8_t dec_len)
{
    char fmt[12];
    char buf[24];
    (void)int_len;
    snprintf(fmt, sizeof(fmt), "%%.%uf", (unsigned int)dec_len);
    snprintf(buf, sizeof(buf), fmt, num);
    OLED_ShowString(x, y, buf);
}

/*
 * 16×16 字模（PCtoLCD / font2c 常见「逐列」导出）：
 * bmp[0..15]  = 列 0..15 的上半部分（字模行 0~7）
 * bmp[16..31] = 列 0..15 的下半部分（字模行 8~15）
 * 字节内 MSB 为字模最上一行。此前误用 bmp[2*col] 会把列序打乱导致接近全空。
 */
void OLED_DrawBMP(uint8_t x0, uint8_t y0, uint8_t x1, uint8_t y1, const uint8_t *bmp)
{
    uint8_t w = (uint8_t)(x1 - x0 + 1U);
    uint8_t h = (uint8_t)(y1 - y0 + 1U);
    uint8_t p0 = (uint8_t)(y0 / 8U);
    uint8_t p1 = (uint8_t)(y1 / 8U);

    for (uint8_t page = p0; page <= p1; page++) {
        for (uint8_t xc = 0; xc < w; xc++) {
            uint8_t col_byte = 0;
            for (uint8_t k = 0; k < 8U; k++) {
                uint8_t py = (uint8_t)(page * 8U + k);
                if (py < y0 || py > y1) {
                    continue;
                }
                uint8_t r = (uint8_t)(py - y0);
                if (r >= h) {
                    continue;
                }
                uint8_t bit_on;
                if (r < 8U) {
                    bit_on = (uint8_t)((bmp[xc] >> (7U - r)) & 1U);
                } else {
                    bit_on = (uint8_t)((bmp[16U + xc] >> (7U - (r - 8U))) & 1U);
                }
                if (bit_on != 0U) {
                    /* COM 反向扫描时常用 D0 为页顶；与字模 MSB 对齐试 (7-k) */
                    col_byte |= (uint8_t)(1U << (7U - k));
                }
            }
            OLED_Set_Pos((uint8_t)(x0 + xc), page);
            OLED_WriteData(col_byte);
        }
    }
}

/* ── Framebuffer: page-major, 128 columns × 8 pages ─────────────── */
static uint8_t oled_fb[OLED_PAGE_NUM][OLED_WIDTH];

void OLED_ClearBuffer(void)
{
    memset(oled_fb, 0, sizeof(oled_fb));
}

void OLED_FlushBuffer(void)
{
    uint8_t page;
    for (page = 0U; page < OLED_PAGE_NUM; page++) {
        OLED_Set_Pos(0U, page);
        OLED_WriteDataBurst(oled_fb[page], OLED_WIDTH);
    }
}

void OLED_FlushPage(uint8_t page)
{
    if (page < OLED_PAGE_NUM) {
        OLED_Set_Pos(0U, page);
        OLED_WriteDataBurst(oled_fb[page], OLED_WIDTH);
    }
}

void OLED_Draw6x8String(uint8_t x, uint8_t page, const char *str)
{
    while (*str != '\0') {
        uint8_t c = (uint8_t)*str;
        if (c < 32U || c > 126U) {
            str++;
            continue;
        }
        const uint8_t *font = F6x8[c - 32U];
        uint8_t col;
        for (col = 0U; col < 6U; col++) {
            if (x + col < OLED_WIDTH && page < OLED_PAGE_NUM) {
                oled_fb[page][x + col] = font[col];
            }
        }
        str++;
        x += 6U;
    }
}
